## components/DroneInertialNavi/Kconfig.projbuild
```kconfig
menu "Drone Inertial Navigation"

    config X_GYRO_OFFSET
        int
        prompt "X Gyro offset"
        default 0

    config Y_GYRO_OFFSET
        int
        prompt "Y Gyro offset"
        default 0

    config Z_GYRO_OFFSET
        int
        prompt "Z Gyro offset"
        default 0

    config Z_ACCEL_OFFSET
        int
        prompt "Z Accelerator offset"
        default 0

endmenu
```

## sdkconfig.defaults
```kconfig
#
# Partition Table
#
CONFIG_PARTITION_TABLE_CUSTOM=y
CONFIG_PARTITION_TABLE_CUSTOM_FILENAME="partitions.csv"
CONFIG_PARTITION_TABLE_FILENAME="partitions.csv"

#
# ESP32-specific
#
CONFIG_ESP32_DEFAULT_CPU_FREQ_240=y
CONFIG_ESP32_DEFAULT_CPU_FREQ_MHZ=240

CONFIG_WIDTH=240
CONFIG_HEIGHT=240
CONFIG_OFFSETX=0
CONFIG_OFFSETY=0
CONFIG_MOSI_GPIO=19
CONFIG_SCLK_GPIO=18
CONFIG_CS_GPIO=5
CONFIG_DC_GPIO=16
CONFIG_RESET_GPIO=23
CONFIG_BL_GPIO=4
```
